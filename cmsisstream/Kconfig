## cmsisstream/Kconfig
```kconfig
config ZEPHYR_CMSISSTREAM_MODULE
	bool

menuconfig CMSISSTREAM
	bool "CMSIS Stream Library Support"
	help
	  This option enables the CMSIS Stream library.

if CMSISSTREAM

config CMSISSTREAM_EVENT_QUEUE_LENGTH
    int "Length of event queue"
    default 20

config CMSISSTREAM_NB_MAX_EVENTS 
    int "Maximum number of events expected in the system at a given time"
    default 20

config CMSISSTREAM_NB_MAX_BUFS 
    int "Maximum number of buffers expected in the system at a given time"
    default 20

config CMSISSTREAM_STREAM_THREAD_PRIORITY  
    int "Priority of stream thread"
    default 0

config CMSISSTREAM_EVT_HIGH_PRIORITY 
    int "Priority of high priority event thread"
    default 4
config CMSISSTREAM_EVT_NORMAL_PRIORITY 
    int "Priority of normal priority event thread"
    default 5
config CMSISSTREAM_EVT_LOW_PRIORITY 
    int "Priority of low priority event thread"
    default 6

config CMSISSTREAM_EVT_THREAD_STACK_SIZE 
    int "Stack size of event thread"
    default 4096

config CMSISSTREAM_STREAM_THREAD_STACK_SIZE 
    int "Stack size of stream thread"
    default 4096

config CMSISSTREAM_POOL_SIZE 
    int "Size allocated for the memory pools for event system"
    default 8000

config CMSISSTREAM_POOL_SECTION
    string "Linker section where CMSIS Stream memory pool is placed"
    default ".alif_sram0.evt_pool"

endif #CMSISSTREAM
```

## executorch/zephyr/Kconfig
```kconfig
# Copyright (c) 2025 Arm Limited and/or its affiliates.
# SPDX-License-Identifier: Apache-2.0

menuconfig EXECUTORCH
	bool "ExecuTorch ML Runtime"
	help
	  Enable ExecuTorch machine learning runtime support.
	  ExecuTorch is a lightweight runtime for executing PyTorch models
	  on resource-constrained embedded devices.

if EXECUTORCH

config EXECUTORCH_METHOD_ALLOCATOR_POOL_SIZE
	int "Method allocator pool size in bytes"
	default 16384
	help
	  Size of the method allocator pool in bytes. This memory is used
	  for allocating ExecuTorch method instances and their metadata.
	  Default is 16KB which should be sufficient for most small models.
	  Larger models may require more memory.

config EXECUTORCH_TEMP_ALLOCATOR_POOL_SIZE
	int "Temporary allocator pool size in bytes"
	default 2048
	help
	  Size of the temporary allocator pool in bytes. This memory is used
	  for temporary allocations during model execution such as intermediate
	  tensor calculations. Default is 2KB which should be sufficient for
	  simple operations. Complex models may require more memory.

config EXECUTORCH_USE_PREBUILT_LIBS
	bool "Use pre-built ExecuTorch libraries"
	default y
	help
	  Use pre-built ExecuTorch libraries from the ai_layer/engine/lib
	  directory. These libraries are generated by the Docker build workflow.
	  Disable this option to build ExecuTorch from source.

config EXECUTORCH_ETHOS_U_DELEGATE
	bool "Enable Ethos-U NPU delegate"
	depends on CPU_CORTEX_M
	default y if SOC_SERIES_MPS3
	help
	  Enable the Ethos-U NPU delegate for hardware-accelerated inference
	  on Arm Ethos-U equipped devices.

config EXECUTORCH_CORTEX_M_OPTIMIZATIONS
	bool "Enable Cortex-M optimized kernels"
	depends on CPU_CORTEX_M
	default y
	help
	  Enable Cortex-M optimized kernels using CMSIS-NN for improved
	  performance on Arm Cortex-M processors.

endif # EXECUTORCH
```
